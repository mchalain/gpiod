## packages/buildroot/package/gpiod/Config.in
```kconfig
config BR2_PACKAGE_GPIOD
	bool "gpiod: gpio monitor daemon"
	depends on BR2_USE_MMU
	depends on BR2_TOOLCHAIN_HEADERS_AT_LEAST_4_8 # libgpiod
	select BR2_PACKAGE_LIBGPIOD
	select BR2_PACKAGE_LIBCONFIG
	help
	  GPIOD monitors gpio events and start scripts.
	  The daemon loads rules defining a gpio and
	  the scripts to launch when the level of gpio changes.

config BR2_PACKAGE_GPIOD_EXAMPLES
	bool "install example rule files"
	depends on BR2_PACKAGE_GPIOD

comment "gpiod needs a toolchain w/ kernel headers >= 4.8"
	depends on !BR2_USE_MMU
	depends on !BR2_TOOLCHAIN_HEADERS_AT_LEAST_4_8
```
